## configs/troika_defconfig
```kconfig
CONFIG_ARM=y
# CONFIG_LOCALVERSION_AUTO is not set
CONFIG_SKIP_LOWLEVEL_INIT=y
CONFIG_COUNTER_FREQUENCY=26000000
CONFIG_POSITION_INDEPENDENT=y
CONFIG_ARCH_EXYNOS=y
CONFIG_SYS_MALLOC_LEN=0x2000000
CONFIG_SYS_MALLOC_F_LEN=0x16000
CONFIG_TARGET_EXYNOS_MOBILE=y
CONFIG_ENV_SOURCE_FILE="troika"
CONFIG_NR_DRAM_BANKS=3
CONFIG_DEFAULT_DEVICE_TREE="exynos/exynos9610-troika"
CONFIG_SYS_BOOTM_LEN=0x2000000
CONFIG_SUPPORT_RAW_INITRD=y
CONFIG_SYS_LOAD_ADDR=0x80000000
CONFIG_ARMV8_CNTFRQ_BROKEN=y
# CONFIG_PSCI_RESET is not set
CONFIG_BUTTON_CMD=y
CONFIG_USE_PREBOOT=y
CONFIG_SAVE_PREV_BL_FDT_ADDR=y
CONFIG_SAVE_PREV_BL_INITRAMFS_START_ADDR=y
CONFIG_SYS_PBSIZE=1024
CONFIG_BOARD_TYPES=y
# CONFIG_REQUIRE_SERIAL_CONSOLE is not set
# CONFIG_DISPLAY_CPUINFO is not set
CONFIG_MISC_INIT_R=y
CONFIG_HUSH_PARSER=y
CONFIG_CMD_BOOTMENU=y
CONFIG_CMD_POWEROFF=y
CONFIG_CMD_FS_GENERIC=y
CONFIG_EFI_PARTITION=y
CONFIG_OF_UPSTREAM=y
CONFIG_OF_UPSTREAM_BUILD_VENDOR=y
CONFIG_OF_BOARD=y
CONFIG_BUTTON=y
CONFIG_BUTTON_REMAP_PHONE_KEYS=y
CONFIG_CLK_EXYNOS9610=y
CONFIG_USB_FUNCTION_FASTBOOT=y
CONFIG_FASTBOOT_BUF_ADDR=0xc0000000
CONFIG_FASTBOOT_BUF_SIZE=0x1fe00000
CONFIG_FASTBOOT_FLASH=y
CONFIG_FASTBOOT_FLASH_BLOCK=y
CONFIG_FASTBOOT_FLASH_BLOCK_INTERFACE_NAME="scsi"
CONFIG_FASTBOOT_FLASH_BLOCK_DEVICE_ID=0
CONFIG_CONSOLE_RECORD=y
CONFIG_CONSOLE_RECORD_INIT_F=y
CONFIG_CONSOLE_RECORD_OUT_SIZE=0x20000
CONFIG_BUTTON_KEYBOARD=y
CONFIG_MISC=y
CONFIG_PINCTRL=y
CONFIG_PINCTRL_EXYNOS9610=y
CONFIG_SOC_SAMSUNG=y
CONFIG_EXYNOS_PMU=y
CONFIG_SYSRESET=y
CONFIG_SYSRESET_CMD_POWEROFF=y
CONFIG_SYSRESET_SYSCON=y
CONFIG_USB=y
CONFIG_DM_USB_GADGET=y
CONFIG_USB_DWC3=y
CONFIG_USB_DWC3_GENERIC=y
CONFIG_USB_GADGET=y
CONFIG_USB_GADGET_MANUFACTURER="Motorola"
CONFIG_USB_GADGET_VENDOR_NUM=0x18d1
CONFIG_USB_GADGET_PRODUCT_NUM=0xd00d
CONFIG_VIDEO=y
CONFIG_VIDEO_SIMPLE=y
# CONFIG_VIDEO_FONT_8X16 is not set
# CONFIG_VIDEO_FONT_16X32 is not set
CONFIG_VIDEO_FONT_32X64=y
CONFIG_FS_EXT4=y
CONFIG_FS_FAT=y
CONFIG_SCSI=y
CONFIG_DM_SCSI=y
CONFIG_CMD_SCSI=y
CONFIG_UFS=y
CONFIG_CMD_UFS=y
CONFIG_UFS_EXYNOS=y
CONFIG_PHY=y
CONFIG_PHY_EXYNOS_USBDRD=y

CONFIG_BLKMAP=y
CONFIG_CMD_BLKMAP=y
CONFIG_DOS_PARTITION=y

CONFIG_FASTBOOT_OEM_RUN=y
CONFIG_FASTBOOT_CMD_OEM_CONSOLE=y
```
