// SPDX-License-Identifier: GPL-2.0
/*
 * Copyright (c) 2026 Sean Hoyt <seanhoyt963@gmail.com>
 *
 * simplefb framebuffer address/resolution match Motorola LK bootloader's
 * DISPLAY_BUFFER_ADDR (0xed000000) and panel dimensions (1080x2520 21:9 panel).
 * Motorola LK leaves continuous splash (cont-splash-enabled) scanning out
 * from 0xed000000.
 */

/ {
	model_info-chip = <9610>;
	model_info-hw_rev = <0>;
	model_info-hw_rev_end = <255>;

	chosen {
		stdout-path = "serial0:115200n8";
		#address-cells = <1>;
		#size-cells = <1>;
		ranges;

		framebuffer@ed000000 {
			compatible = "simple-framebuffer";
			reg = <0xed000000 (1080 * 2520 * 4)>;
			width = <1080>;
			height = <2520>;
			stride = <(1080 * 4)>;
			format = "a8r8g8b8";
		};
	};
};
